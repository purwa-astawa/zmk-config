## boards/shields/minidactyl/Kconfig.shield
```kconfig
config SHIELD_MINIDACTYL_LEFT
    def_bool $(shields_list_contains,minidactyl_left)

config SHIELD_MINIDACTYL_RIGHT
    def_bool $(shields_list_contains,minidactyl_right)
```
